## drivers/uart_lp/Kconfig
```kconfig
menuconfig UART_LP
	bool "LP UART wrapper"
	depends on PM_DEVICE
	depends on HEAP_MEM_POOL_SIZE > 0
	help
	  Enable LP UART wrapper for easier use of the lp-uart

if UART_LP

config UART_LP_BUF_SIZE
	int "LP UART buffer size"
	default 64
	help
	  The LP UART wrapper buffer size in bytes

config UART_LP_TERMINATOR
	hex "Line terminator to use"
	default 0x0A
	help
	  The line terminator to use. This character must not appear inside the strings that are sent.
	  The default value of 0x0A is the new line character.
	  This character is appended automatically to the end of the string and removed when calling the
	  receiver callback.

module = UART_LP
module-str = uart-lp
source "subsys/logging/Kconfig.template.log_config"

endif  # UART_LP
```

## dts/bindings/irnas,lpuart.yaml
```yaml
# Copyright (c) 2022 IRNAS d.o.o
# SPDX-License-Identifier: Apache-2.0

description: |
  Driver for actual lpw power uart
  Example definition in devicetree:

  uart1 {
    status = "okay";
    current-speed = <115200>;
    rx-pin = <22>;
    tx-pin = <23>;
    /delete-property/ rts-pin;
    /delete-property/ cts-pin;

    lpuart {
      compatible = "irnas,lpuart";
      status = "okay";
      label = "LPUART";
      req-pin = <1>;
      rdy-pin = <14>;
    };
  };

compatible: "irnas,lpuart"

include: uart-device.yaml

properties:
  signal-gpios:
    type: phandle-array
    required: true
    description: |
      GPIO responsible for signaling the enabling of uart
```

## dts/bindings/irnas,uart_lp.yaml
```yaml
# Copyright (c) 2022 IRNAS d.o.o
# SPDX-License-Identifier: Apache-2.0

description: |
  Driver for actual lpw power uart
  Example definition in devicetree:

  uart1 {
    // ...

    uart_lp {
      compatible = "irnas,uart_lp";
      status = "okay";
      label = "UART_LP";
      signal-gpios = <&gpio0 1 (GPIO_ACTIVE_HIGH | GPIO_PULL_DOWN)>;
    };
  };

compatible: "irnas,uart_lp"

include: uart-device.yaml

properties:
  signal-gpios:
    type: phandle-array
    required: true
    description: |
      GPIO responsible for signalling the enabling of uart
```
