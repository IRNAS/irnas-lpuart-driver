## CMakeLists.txt
```
# COPYRIGHT NOTICE: (c) 2022 Irnas. All rights reserved.

cmake_minimum_required(VERSION 3.13.1)

# create compile_commands.json for clang
set(CMAKE_EXPORT_COMPILE_COMMANDS on)

# We define the nrf52840dk overlay once in the root boards directory, but now have
# to add it here manually since it is not where west expects it to be
if(${BOARD} STREQUAL nrf52840dk_nrf52840)
  list(APPEND DTC_OVERLAY_FILE
    "${CMAKE_CURRENT_SOURCE_DIR}/../../boards/nrf52840dk_nrf52840.overlay"
  )
endif()

find_package(Zephyr REQUIRED HINTS $ENV{ZEPHYR_BASE})

project(sentek-iot-probe-lpuart-test)

zephyr_compile_options(-fdiagnostics-color=always)

target_sources(app PRIVATE
  src/main.c
)
```

## prj.conf
```kconfig
# requires heap
CONFIG_HEAP_MEM_POOL_SIZE=1024

# log
CONFIG_LOG=y
CONFIG_LOG_MODE_IMMEDIATE=y
# log via UART
CONFIG_LOG_BACKEND_UART=y

# power management
CONFIG_PM=y
CONFIG_PM_DEVICE=y

# make sure the UART used with uart_lp is interrupt driven
CONFIG_NRFX_UARTE1=y
CONFIG_UART_ASYNC_API=n
CONFIG_UART_1_ASYNC=n
CONFIG_UART_1_NRF_HW_ASYNC=n
CONFIG_UART_INTERRUPT_DRIVEN=y
CONFIG_UART_1_INTERRUPT_DRIVEN=y

# enable driver
CONFIG_UART_LP=y
```

## src/main.c
```c
#include <logging/log.h>
#include <uart_lp.h>
#include <zephyr.h>

LOG_MODULE_REGISTER(main);

char *messages[] = {
	"hello",
	"aloha",
	"zdravo",
};

static void uart_lp_receive_handler(char *msg)
{
	/* print what was received */
	LOG_INF("RECEIVED: [%s]", msg);
}

void main(void)
{
	int err;

	err = uart_lp_init();
	if (err) {
		LOG_ERR("uart_lp_init, err: %d", err);
		return;
	}
	uart_lp_set_receive_handler(uart_lp_receive_handler);

	/* send a message every so often */
	while (1) {
		for (int i = 0; i < ARRAY_SIZE(messages); i++) {
			LOG_INF("SENDING: [%s]", messages[i]);
			uart_lp_send_data(messages[i]);
			k_sleep(K_SECONDS(1));
		}
	}
}
```
